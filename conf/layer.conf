## conf/layer.conf
```bitbake
# We have a conf and classes directory, add to BBPATH
BBPATH .= ":${LAYERDIR}"

# We have recipes-* directories, add to BBFILES
BBFILES += "${LAYERDIR}/recipes-*/*/*.bb \
            ${LAYERDIR}/recipes-*/*/*.bbappend"

BBFILE_COLLECTIONS += "meta-aws-examples"
BBFILE_PATTERN_meta-aws-examples = "^${LAYERDIR}/"
BBFILE_PRIORITY_meta-aws-examples = "6"

LAYERDEPENDS_meta-aws-examples = "core"
LAYERSERIES_COMPAT_meta-aws-examples = "kirkstone langdale"
```
